## configs/p_a5_tab_reva_defconfig
```kconfig
BR2_arm=y
BR2_cortex_a5=y
# BR2_ARM_ENABLE_VFP=y
BR2_ARM_INSTRUCTIONS_THUMB2=y
BR2_PACKAGE_HOST_LINUX_HEADERS_4_9=y

BR2_INIT_BUSYBOX=y
BR2_TARGET_ROOTFS_UBIFS=y
BR2_TARGET_ROOTFS_UBIFS_LEBSIZE=0x1f000
BR2_TARGET_ROOTFS_UBI=y
BR2_TARGET_ROOTFS_UBI_SUBSIZE=2048
BR2_KERNEL_HEADERS_4_9=y
BR2_TARGET_GENERIC_GETTY_BAUDRATE_115200=y
BR2_TARGET_GENERIC_GETTY_PORT=ttyS0
BR2_TARGET_GENERIC_GETTY=y

BR2_PACKAGE_PYTHON=y
BR2_PACKAGE_PYTHON_SERIAL=y
BR2_TARGET_ROOTFS_EXT2=y

BR2_TARGET_ROOTFS_INITRAMFS=y
BR2_TOOLCHAIN_BUILDROOT_GLIBC=y
```

## configs/startrack_defconfig
```kconfig
BR2_arm=y
BR2_cortex_a5=y
BR2_ARM_ENABLE_NEON=y
BR2_ARM_FPU_NEON=y
BR2_ARM_ENABLE_VFP=y
BR2_TOOLCHAIN_EXTERNAL=y
BR2_ROOTFS_POST_IMAGE_SCRIPT="support/scripts/genimage.sh"
BR2_ROOTFS_POST_SCRIPT_ARGS="-c board/startrack/genimage-startrack.cfg"
BR2_LINUX_KERNEL=y
BR2_LINUX_KERNEL_CUSTOM_GIT=y
BR2_LINUX_KERNEL_CUSTOM_REPO_URL="https://github.com/mcoromac/linux-at91.git"
BR2_LINUX_KERNEL_CUSTOM_REPO_VERSION="NeonTest"
BR2_LINUX_KERNEL_DEFCONFIG="p_a5_tab_reva"
BR2_LINUX_KERNEL_DTS_SUPPORT=y
BR2_LINUX_KERNEL_INTREE_DTS_NAME="p_a5_tab_reva"
BR2_TARGET_ROOTFS_EXT2=y
BR2_TARGET_ROOTFS_EXT2_4=y
# BR2_TARGET_ROOTFS_TAR is not set
BR2_TARGET_AT91BOOTSTRAP3=y
BR2_TARGET_AT91BOOTSTRAP3_CUSTOM_GIT=y
BR2_TARGET_AT91BOOTSTRAP3_CUSTOM_REPO_URL="https://github.com/mcoromac/at91bootstrap.git"
BR2_TARGET_AT91BOOTSTRAP3_CUSTOM_REPO_VERSION="LT"
BR2_TARGET_AT91BOOTSTRAP3_DEFCONFIG="p_a5_tab_revaemmc"
BR2_TARGET_UBOOT=y
BR2_TARGET_UBOOT_BUILD_SYSTEM_KCONFIG=y
BR2_TARGET_UBOOT_CUSTOM_GIT=y
BR2_TARGET_UBOOT_CUSTOM_REPO_URL="https://github.com/mcoromac/u-boot-at91.git"
BR2_TARGET_UBOOT_CUSTOM_REPO_VERSION="uart_console"
BR2_TARGET_UBOOT_BOARD_DEFCONFIG="p_a5_tab_reva"
BR2_TARGET_UBOOT_NEEDS_DTC=y
BR2_PACKAGE_HOST_DOSFSTOOLS=y
BR2_PACKAGE_HOST_GENIMAGE=y
BR2_PACKAGE_HOST_MTOOLS=y
BR2_PACKAGE_HOST_SAM_BA=y
BR2_PACKAGE_PYTHON=y
BR2_PACKAGE_PYTHON_READLINE=y
BR2_PACKAGE_PYTHON_SERIAL=y
BR2_PACKAGE_PYTHON_SPIDEV=y
BR2_PACKAGE_SPIDEV_TEST=y
BR2_PACKAGE_JAMVM=y
BR2_PACKAGE_NANO=y
#BR2_PACKAGE_NANO_TINY is not set
BR2_PACKAGE_USBMOUNT=y
BR2_PACKAGE_LSSCSI=y
BR2_PACKAGE_HWDATA=y
BR2_PACKAGE_USBUTILS=y
BR2_PACKAGE_SPI_TOOLS=y
BR2_PACKAGE_LIBSOC=y	
BR2_PACKAGE_MOTION=n
BR2_PACKAGE_OPENSSL=y
BR2_PACKAGE_LIBNSS=y
BR2_PACKAGE_LIBGLIB2=y
BR2_PACKAGE_LIBUSB=y
BR2_PACKAGE_PIXMAN=y
BR2_ROOTFS_DEVICE_CREATION_STATIC=n
BR2_ROOTFS_DEVICE_CREATION_DYNAMIC_DEVTMPFS=n
BR2_ROOTFS_DEVICE_CREATION_DYNAMIC_MDEV=n
BR2_ROOTFS_DEVICE_CREATION_DYNAMIC_EUDEV=y
BR2_PACKAGE_HOST_PKGCONF=y
BR2_PACKAGE_LIBFPRINT=y
BR2_ROOTFS_OVERLAY="board/startrack/tab6/rootfs-overlay"
BR2_PACKAGE_FINGERPRINT=n
BR2_PACKAGE_STRACE=y
BR2_PACKAGE_PYTHON_CFFI=y
BR2_PACKAGE_PYTHON_PYFPRINT=y
BR2_PACKAGE_PYTHON_PILLOW=y
BR2_PACKAGE_PYTHON_PYUSB=y
BR2_PACKAGE_FSWEBCAM=y
BR2_PACKAGE_OPENCV3=y
BR2_PACKAGE_OPENCV3_LIB_PYTHON=y
BR2_PACKAGE_OPENCV3_LIB_OBJDETECT=y
BR2_TARGET_ROOTFS_EXT2_SIZE="150M"
BR2_PACKAGE_LIBV4L_UTILS=y
BR2_PACKAGE_LIBV4L=y
BR2_PACKAGE_OPENCV3_LIB_FEATURES2D=y
BR2_PACKAGE_OPENCV3_LIB_IMGCODECS=y
BR2_PACKAGE_OPENCV3_LIB_TS=y
BR2_PACKAGE_OPENCV3_LIB_VIDEOIO=y
BR2_PACKAGE_OPENCV3_LIB_VIDEO=y
BR2_PACKAGE_OPENCV3_LIB_CALIB3D=y
BR2_PACKAGE_OPENCV3_BUILD_TESTS=y
BR2_PACKAGE_OPENCV3_WITH_JPEG=y
BR2_PACKAGE_OPENCV3_WITH_V4L=y
BR2_PACKAGE_LIBWEBCAM=y
BR2_PACKAGE_IMAGEMAGICK=y
BR2_PACKAGE_LIBJPEG=y
BR2_PACKAGE_OPROFILE=y
BR2_PACKAGE_ATOP=y
BR2_PACKAGE_IOTOP=y
BR2_PACKAGE_CPULOAD=y
BR2_PACKAGE_FTOP=y
BR2_PACKAGE_HTOP=y

BR2_PACKAGE_BLUEZ_UTILS=y
BR2_PACKAGE_DHCPCD=y
BR2_PACKAGE_BUSYBOX_SHOW_OTHERS=y
BR2_PACKAGE_DHCP=y
BR2_PACKAGE_DHCP_SERVER=y
BR2_PACKAGE_HOSTAPD=y
BR2_PACKAGE_WPA_SUPPLICANT=y
BR2_PACKAGE_IW=y
BR2_PACKAGE_WIRELESS_TOOLS=y
BR2_PACKAGE_IPROUTE2=y
BR2_PACKAGE_IPUTILS=y
BR2_PACKAGE_OPENSSH=y
BR2_PACKAGE_WPA_SUPPLICANT_EAP=y
BR2_PACKAGE_WPA_SUPPLICANT_CLI=y
BR2_PACKAGE_WPA_SUPPLICANT_PASSPHRASE=y
BR2_PACKAGE_WPA_SUPPLICANT_AP_SUPPORT=y
# BR2_PACKAGE_WPA_SUPPLICANT_HOTSPOT is not set
BR2_PACKAGE_HOSTAPD_EAP=y
BR2_PACKAGE_HOSTAPD_WPS=y
BR2_PACKAGE_GPSD=y
BR2_PACKAGE_GPSD_SIRF=y

BR2_PACKAGE_TINYMEMBENCH=y
BR2_PACKAGE_STRESS=y
#BR2_PACKAGE_IOSTAT=y
BR2_PACKAGE_USB_MODESWITCH=y
BR2_PACKAGE_USB_MODESWITCH_DATA=y
# BR2_PACKAGE_PPPD is not set
# BR2_PACKAGE_MODEM_MANAGER is not set
# BR2_PACKAGE_NETWORK_MANAGER is not set
# BR2_PACKAGE_NETWORK_MANAGER_PPPD is not set
BR2_PACKAGE_IPTABLES=y
BR2_PACKAGE_IFTOP=y
BR2_PACKAGE_IFUPDOWN=y
BR2_PACKAGE_DNSMASQ=y
BR2_PACKAGE_BRIDGE_UTILS=y

BR2_TARGET_GENERIC_HOSTNAME="tab6"
BR2_TARGET_GENERIC_ROOT_PASSWD="startrack"
# BR2_PACKAGE_DHCP_CLIENT is not set
# BR2_PACKAGE_EBTABLES is not set
BR2_PACKAGE_PYTHON_GPS3=y
BR2_PACKAGE_JLIBFPRINT=n
```

## package/fingerprint/Config.in
```kconfig
config BR2_PACKAGE_FINGERPRINT
    bool "fingerprint"
    select BR2_PACKAGE_LIBFPRINT
    help
      Our main fingerprint project
```

## package/jlibfprint/Config.in
```kconfig
config BR2_PACKAGE_JLIBFPRINT
	bool "jlibfprint"
	help
	  Jlibfprint was developed as part of a small project during our
	   studies at the University of Naples (Università degli studi di
	   Napoli Federico II). It was not developed in the sight to 
	   provide a full support to the fingerprint sensors under Linux,
	   but just as basic access to these peripherals under Java.
	  
	  https://github.com/eduardobogoni/
```

## package/libfprint/Config.in
```kconfig
config BR2_PACKAGE_LIBFPRINT
	bool "libfprint"
	select BR2_PACKAGE_PIXMAN
	select BR2_PACKAGE_LIBOPENSSL
	select BR2_PACKAGE_LIBUSB
	select BR2_PACKAGE_LIBGLIB2
	select BR2_PACKAGE_LIBNSS
	help
	  Libfprint is an open source software library designed to make 
	  it easy for application developers to add support for consumer
	   fingerprint readers to their software.

	  https://www.freedesktop.org/wiki/Software/fprint/
```

## package/libwebcam/Config.in
```kconfig
config BR2_PACKAGE_LIBWEBCAM
	bool "libwebcam"
	select BR2_PACKAGE_LIBXML2
	help
	  This project was first developed by logitech and it was
	  hosted at a svn repo in the quickcamteam site, but since then
	   logitech shutdown the site.

	  https://sourceforge.net/projects/libwebcam/?source=navbar
```

## package/python-fprynt/Config.in
```kconfig
config BR2_PACKAGE_PYTHON_FPRYNT
	bool "python-fprynt"
	depends on BR2_PACKAGE_PYTHON
	help
	  Python bindings for libfprint.

	  https://github.com/hfeeki/fprynt
```

## package/python-gps3/Config.in
```kconfig
config BR2_PACKAGE_PYTHON_GPS3
	bool "python-gps3"
	depends on BR2_PACKAGE_PYTHON
	help
	   The simple and efficient Python2.7-3.5 client, is 
	   pre-packaged as a threaded client

	   https://github.com/wadda/gps3
```

## package/python-passport-eye/Config.in
```kconfig
config BR2_PACKAGE_PYTHON_PASSPORT_EYE
	bool "python-passport-eye"
	select BR2_PACKAGE_PYTHON_BCRYPT 
	help
	  The package provides tools for recognizing machine readable 
	  zones (MRZ) from scanned identification documents.

	  https://pypi.org/project/PassportEye/
```

## package/python-pyfprint/Config.in
```kconfig
config BR2_PACKAGE_PYTHON_PYFPRINT
	bool "python-pyfprint"
	depends on BR2_PACKAGE_PYTHON
	help
	  Python bindings for libfprint scanner library.

	  https://github.com/luksan/pyfprint
```

## package/python-pytesseract/Config.in
```kconfig
config BR2_PACKAGE_PYTHON_PYTESSERACT
	bool "python-pytesseract"
	select BR2_PACKAGE_PYTHON_PILLOW
	help
	  Python-tesseract is an optical character recognition 
	  (OCR) tool for python.

	  https://pypi.org/project/pytesseract/
```

## package/python-scipy/Config.in
```kconfig
config BR2_PACKAGE_PYTHON_SCIPY
	bool "python-scipy"
	select BR2_PACKAGE_PYTHON_NUMPY
	help
	  SciPy (pronounced 'Sigh Pie') is open-source software
	  for mathematics, science, and engineering.

	  https://pypi.org/project/scipy/
```
